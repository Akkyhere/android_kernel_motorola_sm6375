## arch/arm64/boot/dts/vendor/Kconfig
```kconfig
# SPDX-License-Identifier: GPL-2.0-only
# Vendor Device Tree Kconfig menu

menu "Vendor Device Tree configuration"

source "arch/arm64/boot/dts/vendor/qcom/Kconfig"

endmenu
```

## arch/arm64/boot/dts/vendor/qcom/Kconfig
```kconfig
menu "Motorola Device Trees"

config RHODEP_DTB
    bool "Motorola G82 (rhodep)"
    default y
    help
      Enable building device tree overlays and DTBO images for
      Motorola G82 (codename: rhodep). This ensures all device tree
      overlays (DTBOs) specific to rhodep are included in the build.

endmenu
```
